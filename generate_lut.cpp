#include <cstdint>
#include <fstream>
#include <iomanip>
#include <iostream>
#include <stdexcept>

#include "engine.h"

namespace {

bool isLutEligible(const ttt::Board& board) {
    ttt::GameResult state = ttt::inspect(board);
    return ttt::isLegalReachable(board) &&
           ttt::isAiTurnBoard(board) &&
           state.winner == ttt::EMPTY &&
           !state.full;
}

void validatePackedMove(const ttt::Board& board, std::uint8_t packed) {
    std::uint8_t move1 = ttt::primaryMove(packed);
    std::uint8_t move2 = ttt::alternateMove(packed);

    if (move1 > 8 || board.cell[move1] != ttt::EMPTY) {
        throw std::runtime_error("generated invalid primary move");
    }

    if (move2 != ttt::NO_MOVE && (move2 > 8 || board.cell[move2] != ttt::EMPTY)) {
        throw std::runtime_error("generated invalid alternate move");
    }

    if (move2 == ttt::NO_MOVE) {
        return;
    }

    ttt::Board probe = board;
    ttt::MoveScore primary = ttt::scoreAiMove(probe, move1);
    ttt::MoveScore alternate = ttt::scoreAiMove(probe, move2);
    if (!ttt::samePerfectScore(primary, alternate)) {
        throw std::runtime_error("alternate move is not a perfect-score tie");
    }
}

void writeHeaderStart(std::ofstream& out) {
    out << "#ifndef TTT_LUT_H\n"
        << "#define TTT_LUT_H\n\n"
        << "#include <stdint.h>\n\n"
        << "#ifndef PROGMEM\n"
        << "#define PROGMEM\n"
        << "#endif\n\n"
        << "// Generated by generate_lut.cpp. Index is the base-3 encoded board.\n"
        << "// High nibble = primary move, low nibble = tied alternate or 0xF.\n"
        << "// 0xFF marks invalid, impossible, terminal, or non-AI-turn boards.\n"
        << "const uint8_t BEST_MOVE[19683] PROGMEM = {\n";
}

void writeHeaderEnd(std::ofstream& out) {
    out << "};\n\n"
        << "#endif\n";
}

}  // namespace

int main() {
    std::ofstream out("lut.h");
    if (!out) {
        std::cerr << "failed to open lut.h for writing\n";
        return 1;
    }

    int validCount = 0;
    int invalidCount = 0;
    int alternateCount = 0;

    writeHeaderStart(out);

    for (int key = 0; key < ttt::BOARD_COUNT; key++) {
        ttt::Board board = ttt::decodeBoard(static_cast<std::uint16_t>(key));
        std::uint8_t packed = ttt::PACKED_INVALID;

        if (isLutEligible(board)) {
            packed = ttt::choosePackedAiMoves(board);
            validatePackedMove(board, packed);
            validCount++;

            if (ttt::alternateMove(packed) != ttt::NO_MOVE) {
                alternateCount++;
            }
        } else {
            invalidCount++;
        }

        if (key % 16 == 0) {
            out << "    ";
        }

        out << "0x"
            << std::uppercase << std::hex << std::setw(2) << std::setfill('0')
            << static_cast<int>(packed)
            << std::dec;

        if (key + 1 != ttt::BOARD_COUNT) {
            out << ',';
        }

        if (key % 16 == 15 || key + 1 == ttt::BOARD_COUNT) {
            out << '\n';
        } else {
            out << ' ';
        }
    }

    writeHeaderEnd(out);

    std::cout << "generated lut.h with " << ttt::BOARD_COUNT << " entries\n";
    std::cout << "valid AI-turn entries: " << validCount << '\n';
    std::cout << "invalid/terminal/non-AI-turn entries: " << invalidCount << '\n';
    std::cout << "entries with alternate tied move: " << alternateCount << '\n';

    return 0;
}
